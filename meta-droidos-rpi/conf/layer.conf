## meta-droidos-rpi/conf/layer.conf
```bitbake
# DroidOS Raspberry Pi board layer (spec §6.2).
BBPATH .= ":${LAYERDIR}"
BBFILES += "${LAYERDIR}/recipes-*/*/*.bb ${LAYERDIR}/recipes-*/*/*.bbappend"
BBFILE_COLLECTIONS += "droidos-rpi"
BBFILE_PATTERN_droidos-rpi = "^${LAYERDIR}/"
BBFILE_PRIORITY_droidos-rpi = "25"
LAYERVERSION_droidos-rpi = "1"
LAYERSERIES_COMPAT_droidos-rpi = "scarthgap"
LAYERDEPENDS_droidos-rpi = "droidos raspberrypi"
```

## meta-droidos-rpi/conf/machine/droidos-rpi5.conf
```bitbake
#@TYPE: Machine
#@NAME: droidos-rpi5
#@DESCRIPTION: DroidOS on Raspberry Pi 5 (spec §7.1). Suitable for basic cameras,
# ROS 2, diagnostics, voice, TTS, remote or lightweight local LLM, task planning,
# navigation, walking-policy inference and general droid coordination.

require conf/machine/raspberrypi5.conf

MACHINEOVERRIDES =. "droidos-rpi5:"

PREFERRED_PROVIDER_virtual/kernel = "linux-droidos"
DROIDOS_RT = "1"

# Pi camera + cooling + boot (spec §6.2).
MACHINE_FEATURES:append = " vc4graphics"
RPI_EXTRA_CONFIG = "dtparam=fan_temp0=50000"
KERNEL_DEVICETREE:append = " broadcom/bcm2712-rpi-5-b.dtb"

# The reference compute level: no GPU inference assumed (spec §7). Accelerated
# services must have a CPU-compatible fallback.
DROIDOS_LOCAL_LLM = "llama-cpp"
DROIDOS_GPU_INFERENCE = "0"
```

## meta-droidos-tegra/conf/layer.conf
```bitbake
# DroidOS NVIDIA Jetson board layer (spec §6.3).
BBPATH .= ":${LAYERDIR}"
BBFILES += "${LAYERDIR}/recipes-*/*/*.bb ${LAYERDIR}/recipes-*/*/*.bbappend"
BBFILE_COLLECTIONS += "droidos-tegra"
BBFILE_PATTERN_droidos-tegra = "^${LAYERDIR}/"
BBFILE_PRIORITY_droidos-tegra = "25"
LAYERVERSION_droidos-tegra = "1"
LAYERSERIES_COMPAT_droidos-tegra = "scarthgap"
# The selected vendor BSP, Yocto release, GPU libraries and kernel must be pinned
# as one tested set (spec §6.3).
LAYERDEPENDS_droidos-tegra = "droidos tegra"
```

## meta-droidos-tegra/conf/machine/droidos-orin.conf
```bitbake
#@TYPE: Machine
#@NAME: droidos-orin
#@DESCRIPTION: DroidOS on NVIDIA Jetson Orin (spec §7.2). Suitable for multiple
# cameras, continuous object detection, depth/3D perception, local speech and TTS,
# local LLM inference, vision-language models, semantic mapping and sensor recording.
#
# The NVIDIA build MUST use a compatible vendor BSP; the BSP, Yocto release, GPU
# libraries and kernel are pinned as a tested set (spec §6.3).

require conf/machine/include/tegra-common.inc

MACHINEOVERRIDES =. "droidos-orin:"
PREFERRED_PROVIDER_virtual/kernel = "linux-droidos"

# GPU-accelerated inference available; every accelerated service still declares a
# CPU-compatible fallback and a minimum-hardware requirement (spec §7).
DROIDOS_GPU_INFERENCE = "1"
DROIDOS_LOCAL_LLM = "llama-cpp-cuda"

# CUDA / TensorRT packages contributed by the vendor layer (spec §6.3).
MACHINE_FEATURES:append = " cuda tensorrt"
DROIDOS_RT ?= "0"
```

## meta-droidos/conf/distro/droidos.conf
```bitbake
# DroidOS distribution definition (spec §4, §5, §6).
# Built with the Yocto Project (Scarthgap 5.0 LTS). Pin exact release tags and
# commit hashes in your build manifest rather than following branches (spec §6).

DISTRO = "droidos"
DISTRO_NAME = "DroidOS"
DISTRO_VERSION = "1.0.0"
DISTRO_CODENAME = "gonk"
SDK_VENDOR = "-droidossdk"
MAINTAINER = "DroidOS project"

# Kernel is branded but not rewritten (spec §5): Linux 6.x-droidos.
DROIDOS_KERNEL_SUFFIX ?= "droidos"

# ---------------------------------------------------------------------------- #
# Distro features
# ---------------------------------------------------------------------------- #
DISTRO_FEATURES:append = " systemd usrmerge seccomp security"
DISTRO_FEATURES:remove = " sysvinit x11"
INIT_MANAGER = "systemd"
VIRTUAL-RUNTIME_init_manager = "systemd"
VIRTUAL-RUNTIME_dev_manager = "systemd"

# Real-time where the board kernel supports it (spec §5). PREEMPT_RT makes Linux
# substantially more preemptible for time-sensitive workloads; it does NOT replace
# the independent motor controllers.
DROIDOS_RT ?= "1"

# ---------------------------------------------------------------------------- #
# Security & update posture (spec §31, §33)
# ---------------------------------------------------------------------------- #
# Read-only root filesystem with A/B slots and RAUC-based signed updates.
IMAGE_FEATURES:append = " read-only-rootfs"
DROIDOS_UPDATE_STRATEGY ?= "rauc-ab"
DISTRO_FEATURES:append = " rauc"

# Sign kernel + bundles. Keys are provided out-of-band by the build system and are
# never checked into the source tree.
DROIDOS_SIGN_KEYDIR ?= "${TOPDIR}/keys"

# ---------------------------------------------------------------------------- #
# Preferred versions (pin exact values in the build manifest)
# ---------------------------------------------------------------------------- #
PREFERRED_VERSION_linux-droidos ?= "6.6%"
# ROS 2 Lyrical Luth (LTS, May 2026 -> May 2031) validated with this distro.
DROIDOS_ROS_DISTRO ?= "lyrical"

# Provider-neutral local inference is available but optional (spec §15).
DROIDOS_LOCAL_LLM ?= "llama-cpp"

# ---------------------------------------------------------------------------- #
# Baseline image contents contributed by DroidOS recipes
# ---------------------------------------------------------------------------- #
DISTRO_EXTRA_RDEPENDS += " \
    droidos-supervisor \
    droidos-safety-gateway \
    droidos-runtime \
    droidos-interfaces \
    droidos-bodies \
"

# A successful boot must NOT enable movement; motor power defaults disabled and the
# supervisor only permits motion after all checks pass (spec §8, §40). Enforced by
# the runtime + systemd ordering, not by the image build.
```

## meta-droidos/conf/layer.conf
```bitbake
# DroidOS shared distribution layer (spec §6.1).
# Everything common to all droids lives here; board specifics live in
# meta-droidos-rpi and meta-droidos-tegra.

BBPATH .= ":${LAYERDIR}"
BBFILES += "${LAYERDIR}/recipes-*/*/*.bb ${LAYERDIR}/recipes-*/*/*.bbappend"

BBFILE_COLLECTIONS += "droidos"
BBFILE_PATTERN_droidos = "^${LAYERDIR}/"
BBFILE_PRIORITY_droidos = "20"

LAYERVERSION_droidos = "1"
LAYERSERIES_COMPAT_droidos = "scarthgap"

# DroidOS depends on core, OpenEmbedded and the ROS layer.
LAYERDEPENDS_droidos = "core openembedded-layer"
```
